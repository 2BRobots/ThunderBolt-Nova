; Swordfish Structured BASIC Compiler for PICmicros.
; Version 1.1.6.3 SE Copyright Mecanique 2013
;
; C:\Users\David Fernandez\Documents\SwordfishSE\Demo project ThunderBolt Nova.BAS 25/01/2017
;
 PROCESSOR PIC18F14K50
 RADIX DEC
 ERRORLEVEL 2
 EXPAND ON
; SPECIAL FUNCTION REGISTERS...
UEP0             EQU 0X0F53
UEP1             EQU 0X0F54
UEP2             EQU 0X0F55
UEP3             EQU 0X0F56
UEP4             EQU 0X0F57
UEP5             EQU 0X0F58
UEP6             EQU 0X0F59
UEP7             EQU 0X0F5A
UEIE             EQU 0X0F5B
UADDR            EQU 0X0F5C
UFRML            EQU 0X0F5D
UFRMLH           EQU 0X0F5E
UFRMH            EQU 0X0F5E
UEIR             EQU 0X0F5F
UIE              EQU 0X0F60
UCFG             EQU 0X0F61
UIR              EQU 0X0F62
USTAT            EQU 0X0F63
UCON             EQU 0X0F64
SRCON0           EQU 0X0F68
SRCON1           EQU 0X0F69
CM2CON0          EQU 0X0F6B
CM2CON1          EQU 0X0F6C
CM1CON0          EQU 0X0F6D
SSPMSK           EQU 0X0F6F
SLRCON           EQU 0X0F76
WPUA             EQU 0X0F77
WPUB             EQU 0X0F78
IOCA             EQU 0X0F79
IOCB             EQU 0X0F7A
ANSEL            EQU 0X0F7E
ANSELH           EQU 0X0F7F
LATA             EQU 0X0F89
LATB             EQU 0X0F8A
LATC             EQU 0X0F8B
DDRA             EQU 0X0F92
TRISA            EQU 0X0F92
DDRB             EQU 0X0F93
TRISB            EQU 0X0F93
DDRC             EQU 0X0F94
TRISC            EQU 0X0F94
OSCTUNE          EQU 0X0F9B
PIE1             EQU 0X0F9D
PIR1             EQU 0X0F9E
IPR1             EQU 0X0F9F
PIE2             EQU 0X0FA0
PIR2             EQU 0X0FA1
IPR2             EQU 0X0FA2
EECON1           EQU 0X0FA6
EECON2           EQU 0X0FA7
EEDATA           EQU 0X0FA8
EEADR            EQU 0X0FA9
RCSTA            EQU 0X0FAB
TXSTA            EQU 0X0FAC
TXREG            EQU 0X0FAD
RCREG            EQU 0X0FAE
SPBRG            EQU 0X0FAF
SPBRGH           EQU 0X0FB0
T3CON            EQU 0X0FB1
TMR3L            EQU 0X0FB2
TMR3LH           EQU 0X0FB3
TMR3H            EQU 0X0FB3
ECCP1AS          EQU 0X0FB6
PWM1CON          EQU 0X0FB7
BAUDCON          EQU 0X0FB8
BAUDCTL          EQU 0X0FB8
PSTRCON          EQU 0X0FB9
REFCON0          EQU 0X0FBA
VREFCON0         EQU 0X0FBA
REFCON1          EQU 0X0FBB
VREFCON1         EQU 0X0FBB
REFCON2          EQU 0X0FBC
VREFCON2         EQU 0X0FBC
CCP1CON          EQU 0X0FBD
CCPR1            EQU 0X0FBE
CCPR1L           EQU 0X0FBE
CCPR1LH          EQU 0X0FBF
CCPR1H           EQU 0X0FBF
ADCON2           EQU 0X0FC0
ADCON1           EQU 0X0FC1
ADCON0           EQU 0X0FC2
ADRES            EQU 0X0FC3
ADRESL           EQU 0X0FC3
ADRESLH          EQU 0X0FC4
ADRESH           EQU 0X0FC4
SSPCON2          EQU 0X0FC5
SSPCON1          EQU 0X0FC6
SSPSTAT          EQU 0X0FC7
SSPADD           EQU 0X0FC8
SSPBUF           EQU 0X0FC9
T2CON            EQU 0X0FCA
PR2              EQU 0X0FCB
TMR2             EQU 0X0FCC
T1CON            EQU 0X0FCD
TMR1L            EQU 0X0FCE
TMR1LH           EQU 0X0FCF
TMR1H            EQU 0X0FCF
RCON             EQU 0X0FD0
WDTCON           EQU 0X0FD1
OSCCON2          EQU 0X0FD2
OSCCON           EQU 0X0FD3
T0CON            EQU 0X0FD5
TMR0L            EQU 0X0FD6
TMR0LH           EQU 0X0FD7
TMR0H            EQU 0X0FD7
STATUS           EQU 0X0FD8
FSR2L            EQU 0X0FD9
FSR2LH           EQU 0X0FDA
FSR2H            EQU 0X0FDA
PLUSW2           EQU 0X0FDB
PREINC2          EQU 0X0FDC
POSTDEC2         EQU 0X0FDD
POSTINC2         EQU 0X0FDE
INDF2            EQU 0X0FDF
BSR              EQU 0X0FE0
FSR1L            EQU 0X0FE1
FSR1LH           EQU 0X0FE2
FSR1H            EQU 0X0FE2
PLUSW1           EQU 0X0FE3
PREINC1          EQU 0X0FE4
POSTDEC1         EQU 0X0FE5
POSTINC1         EQU 0X0FE6
INDF1            EQU 0X0FE7
WREG             EQU 0X0FE8
FSR0L            EQU 0X0FE9
FSR0LH           EQU 0X0FEA
FSR0H            EQU 0X0FEA
PLUSW0           EQU 0X0FEB
PREINC0          EQU 0X0FEC
POSTDEC0         EQU 0X0FED
POSTINC0         EQU 0X0FEE
INDF0            EQU 0X0FEF
INTCON3          EQU 0X0FF0
INTCON2          EQU 0X0FF1
INTCON           EQU 0X0FF2
PROD             EQU 0X0FF3
PRODL            EQU 0X0FF3
PRODLH           EQU 0X0FF4
PRODH            EQU 0X0FF4
TABLAT           EQU 0X0FF5
TBLPTR           EQU 0X0FF6
TBLPTRL          EQU 0X0FF6
TBLPTRLH         EQU 0X0FF7
TBLPTRH          EQU 0X0FF7
TBLPTRU          EQU 0X0FF8
PC               EQU 0X0FF9
PCL              EQU 0X0FF9
PCLATH           EQU 0X0FFA
PCLATU           EQU 0X0FFB
STKPTR           EQU 0X0FFC
TOS              EQU 0X0FFD
TOSL             EQU 0X0FFD
TOSLH            EQU 0X0FFE
TOSH             EQU 0X0FFE
TOSU             EQU 0X0FFF
; SYSTEM PORTS...
PORTC            EQU 0X0F82
PORTB            EQU 0X0F81
PORTA            EQU 0X0F80
; UEP0
EPSTALL = 0
EPINEN = 1
EPOUTEN = 2
EPCONDIS = 3
EPHSHK = 4
; UEP1
EPSTALL = 0
EPINEN = 1
EPOUTEN = 2
EPCONDIS = 3
EPHSHK = 4
; UEP2
EPSTALL = 0
EPINEN = 1
EPOUTEN = 2
EPCONDIS = 3
EPHSHK = 4
; UEP3
EPSTALL = 0
EPINEN = 1
EPOUTEN = 2
EPCONDIS = 3
EPHSHK = 4
; UEP4
EPSTALL = 0
EPINEN = 1
EPOUTEN = 2
EPCONDIS = 3
EPHSHK = 4
; UEP5
EPSTALL = 0
EPINEN = 1
EPOUTEN = 2
EPCONDIS = 3
EPHSHK = 4
; UEP6
EPSTALL = 0
EPINEN = 1
EPOUTEN = 2
EPCONDIS = 3
EPHSHK = 4
; UEP7
EPSTALL = 0
EPINEN = 1
EPOUTEN = 2
EPCONDIS = 3
EPHSHK = 4
; UEIE
PIDEE = 0
CRC5EE = 1
CRC16EE = 2
DFN8EE = 3
BTOEE = 4
BTSEE = 7
; UADDR
ADDR0 = 0
ADDR1 = 1
ADDR2 = 2
ADDR3 = 3
ADDR4 = 4
ADDR5 = 5
ADDR6 = 6
; UFRML
FRM0 = 0
FRM1 = 1
FRM2 = 2
FRM3 = 3
FRM4 = 4
FRM5 = 5
FRM6 = 6
FRM7 = 7
; UFRMH
FRM8 = 0
FRM9 = 1
FRM10 = 2
; UEIR
PIDEF = 0
CRC5EF = 1
CRC16EF = 2
DFN8EF = 3
BTOEF = 4
BTSEF = 7
; UIE
URSTIE = 0
UERRIE = 1
ACTVIE = 2
TRNIE = 3
IDLEIE = 4
STALLIE = 5
SOFIE = 6
; UCFG
PPB0 = 0
PPB1 = 1
FSEN = 2
UPUEN = 4
UTEYE = 7
; UIR
URSTIF = 0
UERRIF = 1
ACTVIF = 2
TRNIF = 3
IDLEIF = 4
STALLIF = 5
SOFIF = 6
; USTAT
PPBI = 1
DIR = 2
ENDP0 = 3
ENDP1 = 4
ENDP2 = 5
ENDP3 = 6
; UCON
SUSPND = 1
RESUME = 2
USBEN = 3
PKTDIS = 4
SE0 = 5
PPBRST = 6
; SRCON0
SRPR = 0
SRPS = 1
SRNQEN = 2
SRQEN = 3
SRLEN = 7
SRCLK0 = 4
SRCLK1 = 5
SRCLK2 = 6
; SRCON1
SRRC1E = 0
SRRC2E = 1
SRRCKE = 2
SRRPE = 3
SRSC1E = 4
SRSC2E = 5
SRSCKE = 6
SRSPE = 7
; CM2CON0
C2R = 2
C2SP = 3
C2POL = 4
C2OE = 5
C2OUT = 6
C2ON = 7
C2CH0 = 0
C2CH1 = 1
; CM2CON1
C2SYNC = 0
C1SYNC = 1
C2HYS = 2
C1HYS = 3
C2RSEL = 4
C1RSEL = 5
MC2OUT = 6
MC1OUT = 7
; CM1CON0
C1R = 2
C1SP = 3
C1POL = 4
C1OE = 5
C1OUT = 6
C1ON = 7
C1CH0 = 0
C1CH1 = 1
; SSPMSK
MSK0 = 0
MSK1 = 1
MSK2 = 2
MSK3 = 3
MSK4 = 4
MSK5 = 5
MSK6 = 6
MSK7 = 7
; SLRCON
SLRA = 0
SLRB = 1
SLRC = 2
; WPUA
WPUA3 = 3
WPUA4 = 4
WPUA5 = 5
; WPUB
WPUB4 = 4
WPUB5 = 5
WPUB6 = 6
WPUB7 = 7
; IOCA
IOCA0 = 0
IOCA1 = 1
IOCA3 = 3
IOCA4 = 4
IOCA5 = 5
; IOCB
IOCB4 = 4
IOCB5 = 5
IOCB6 = 6
IOCB7 = 7
; ANSEL
ANS3 = 3
ANS4 = 4
ANS5 = 5
ANS6 = 6
ANS7 = 7
; ANSELH
ANS8 = 0
ANS9 = 1
ANS10 = 2
ANS11 = 3
; PORTA
RA0 = 0
RA1 = 1
RA3 = 3
RA4 = 4
RA5 = 5
AN3 = 4
OSC2 = 4
OSC1 = 5
CLKOUT = 4
CLKIN = 5
; PORTB
RB4 = 4
RB5 = 5
RB6 = 6
RB7 = 7
SDI = 4
RX = 5
SCL = 6
TX = 7
SDA = 4
; DT = 5
SCK = 6
CK = 7
AN10 = 4
AN11 = 5
; PORTC
RC0 = 0
RC1 = 1
RC2 = 2
RC3 = 3
RC4 = 4
RC5 = 5
RC6 = 6
RC7 = 7
AN4 = 0
AN5 = 1
AN6 = 2
AN7 = 3
AN8 = 6
AN9 = 7
C12INP = 0
C12IN1M = 1
C12IN2M = 2
C12IN3M = 3
C12OUT = 4
CCP1 = 5
NOT_SS = 6
INT0 = 0
INT1 = 1
INT2 = 2
PGM = 3
SRQ = 4
T0CKI = 5
T13CKI = 6
T1OSCO = 7
VREFP = 0
VREFM = 1
CVREF = 2
T1OSCI = 6
P1D = 2
P1C = 3
P1B = 4
P1A = 5
SS = 6
SDO = 7
; LATA
LATA4 = 4
LATA5 = 5
; LATB
LATB4 = 4
LATB5 = 5
LATB6 = 6
LATB7 = 7
; LATC
LATC0 = 0
LATC1 = 1
LATC2 = 2
LATC3 = 3
LATC4 = 4
LATC5 = 5
LATC6 = 6
LATC7 = 7
; DDRA
TRISA4 = 4
TRISA5 = 5
RA4 = 4
RA5 = 5
; TRISA
TRISA4 = 4
TRISA5 = 5
RA4 = 4
RA5 = 5
; DDRB
TRISB4 = 4
TRISB5 = 5
TRISB6 = 6
TRISB7 = 7
RB4 = 4
RB5 = 5
RB6 = 6
RB7 = 7
; TRISB
TRISB4 = 4
TRISB5 = 5
TRISB6 = 6
TRISB7 = 7
RB4 = 4
RB5 = 5
RB6 = 6
RB7 = 7
; DDRC
TRISC0 = 0
TRISC1 = 1
TRISC2 = 2
TRISC3 = 3
TRISC4 = 4
TRISC5 = 5
TRISC6 = 6
TRISC7 = 7
RC0 = 0
RC1 = 1
RC2 = 2
RC3 = 3
RC4 = 4
RC5 = 5
RC6 = 6
RC7 = 7
; TRISC
TRISC0 = 0
TRISC1 = 1
TRISC2 = 2
TRISC3 = 3
TRISC4 = 4
TRISC5 = 5
TRISC6 = 6
TRISC7 = 7
RC0 = 0
RC1 = 1
RC2 = 2
RC3 = 3
RC4 = 4
RC5 = 5
RC6 = 6
RC7 = 7
; OSCTUNE
SPLLEN = 6
INTSRC = 7
TUN0 = 0
TUN1 = 1
TUN2 = 2
TUN3 = 3
TUN4 = 4
TUN5 = 5
; PIE1
TMR1IE = 0
TMR2IE = 1
CCP1IE = 2
SSPIE = 3
TXIE = 4
RCIE = 5
ADIE = 6
; PIR1
TMR1IF = 0
TMR2IF = 1
CCP1IF = 2
SSPIF = 3
TXIF = 4
RCIF = 5
ADIF = 6
; IPR1
TMR1IP = 0
TMR2IP = 1
CCP1IP = 2
SSPIP = 3
TXIP = 4
RCIP = 5
ADIP = 6
; PIE2
TMR3IE = 1
USBIE = 2
BCLIE = 3
EEIE = 4
C2IE = 5
C1IE = 6
OSCFIE = 7
; PIR2
TMR3IF = 1
USBIF = 2
BCLIF = 3
EEIF = 4
C2IF = 5
C1IF = 6
OSCFIF = 7
; IPR2
TMR3IP = 1
USBIP = 2
BCLIP = 3
EEIP = 4
C2IP = 5
C1IP = 6
OSCFIP = 7
; EECON1
RD = 0
WR = 1
WREN = 2
WRERR = 3
FREE = 4
CFGS = 6
EEPGD = 7
; EEADR
EEADR0 = 0
EEADR1 = 1
EEADR2 = 2
EEADR3 = 3
EEADR4 = 4
EEADR5 = 5
EEADR6 = 6
EEADR7 = 7
; RCSTA
RX9D = 0
OERR = 1
FERR = 2
ADDEN = 3
CREN = 4
SREN = 5
RX9 = 6
SPEN = 7
ADEN = 3
; TXSTA
TX9D = 0
TRMT = 1
BRGH = 2
SENDB = 3
SYNC = 4
TXEN = 5
TX9 = 6
CSRC = 7
; T3CON
TMR3ON = 0
TMR3CS = 1
NOT_T3SYNC = 2
T3CCP1 = 3
RD16 = 7
T3SYNC = 2
T3CKPS0 = 4
T3CKPS1 = 5
; ECCP1AS
ECCPASE = 7
PSSBD0 = 0
PSSBD1 = 1
PSSAC0 = 2
PSSAC1 = 3
ECCPAS0 = 4
ECCPAS1 = 5
ECCPAS2 = 6
; PWM1CON
PRSEN = 7
PDC0 = 0
PDC1 = 1
PDC2 = 2
PDC3 = 3
PDC4 = 4
PDC5 = 5
PDC6 = 6
; BAUDCON
ABDEN = 0
WUE = 1
BRG16 = 3
CKTXP = 4
DTRXP = 5
RCIDL = 6
ABDOVF = 7
SCKP = 4
; BAUDCTL
ABDEN = 0
WUE = 1
BRG16 = 3
CKTXP = 4
DTRXP = 5
RCIDL = 6
ABDOVF = 7
SCKP = 4
; PSTRCON
STRA = 0
STRB = 1
STRC = 2
STRD = 3
STRSYNC = 4
; REFCON0
FVR1S0 = 4
FVR1S1 = 5
FVR1ST = 6
FVR1EN = 7
; VREFCON0
FVR1S0 = 4
FVR1S1 = 5
FVR1ST = 6
FVR1EN = 7
; REFCON1
D1NSS = 0
DAC1OE = 5
D1LPS = 6
D1EN = 7
D1PSS0 = 2
D1PSS1 = 3
; VREFCON1
D1NSS = 0
DAC1OE = 5
D1LPS = 6
D1EN = 7
D1PSS0 = 2
D1PSS1 = 3
; REFCON2
DAC1R0 = 0
DAC1R1 = 1
DAC1R2 = 2
DAC1R3 = 3
DAC1R4 = 4
; VREFCON2
DAC1R0 = 0
DAC1R1 = 1
DAC1R2 = 2
DAC1R3 = 3
DAC1R4 = 4
; CCP1CON
CCP1M0 = 0
CCP1M1 = 1
CCP1M2 = 2
CCP1M3 = 3
DC1B0 = 4
DC1B1 = 5
P1M0 = 6
P1M1 = 7
; ADCON2
ADFM = 7
ADCS0 = 0
ADCS1 = 1
ADCS2 = 2
ACQT0 = 3
ACQT1 = 4
ACQT2 = 5
; ADCON1
NVCFG0 = 0
NVCFG1 = 1
PVCFG0 = 2
PVCFG1 = 3
; ADCON0
ADON = 0
GO_NOT_DONE = 1
GO = 1
CHS0 = 2
CHS1 = 3
CHS2 = 4
CHS3 = 5
DONE = 1
NOT_DONE = 1
GO_DONE = 1
; SSPCON2
SEN = 0
RSEN = 1
PEN = 2
RCEN = 3
ACKEN = 4
ACKDT = 5
ACKSTAT = 6
GCEN = 7
; SSPCON1
CKP = 4
SSPEN = 5
SSPOV = 6
WCOL = 7
SSPM0 = 0
SSPM1 = 1
SSPM2 = 2
SSPM3 = 3
; SSPSTAT
BF = 0
UA = 1
R_NOT_W = 2
S = 3
P = 4
D_NOT_A = 5
CKE = 6
SMP = 7
R = 2
D = 5
NOT_W = 2
NOT_A = 5
R_W = 2
D_A = 5
NOT_WRITE = 2
NOT_ADDRESS = 5
; T2CON
TMR2ON = 2
T2CKPS0 = 0
T2CKPS1 = 1
T2OUTPS0 = 3
T2OUTPS1 = 4
T2OUTPS2 = 5
T2OUTPS3 = 6
; T1CON
TMR1ON = 0
TMR1CS = 1
NOT_T1SYNC = 2
T1OSCEN = 3
T1RUN = 6
RD16 = 7
T1SYNC = 2
T1CKPS0 = 4
T1CKPS1 = 5
; RCON
NOT_BOR = 0
NOT_POR = 1
NOT_PD = 2
NOT_TO = 3
NOT_RI = 4
SBOREN = 6
IPEN = 7
BOR = 0
POR = 1
PD = 2
TO = 3
RI = 4
; WDTCON
SWDTEN = 0
SWDTE = 0
; OSCCON2
LFIOFS = 0
HFIOFL = 1
PRI_SD = 2
; OSCCON
SCS0 = 0
SCS1 = 1
IOFS = 2
OSTS = 3
IDLEN = 7
IRCF0 = 4
IRCF1 = 5
IRCF2 = 6
; T0CON
PSA = 3
T0SE = 4
T0CS = 5
T08BIT = 6
TMR0ON = 7
T0PS0 = 0
T0PS1 = 1
T0PS2 = 2
; STATUS
C = 0
DC = 1
Z = 2
OV = 3
N = 4
; INTCON3
INT1IF = 0
INT2IF = 1
INT1IE = 3
INT2IE = 4
INT1IP = 6
INT2IP = 7
INT1F = 0
INT2F = 1
INT1E = 3
INT2E = 4
INT1P = 6
INT2P = 7
; INTCON2
RABIP = 0
TMR0IP = 2
INTEDG2 = 4
INTEDG1 = 5
INTEDG0 = 6
NOT_RABPU = 7
RABPU = 7
; INTCON
RABIF = 0
INT0IF = 1
TMR0IF = 2
RABIE = 3
INT0IE = 4
TMR0IE = 5
PEIE_GIEL = 6
GIE_GIEH = 7
INT0F = 1
T0IF = 2
INT0E = 4
T0IE = 5
PEIE = 6
GIE = 7
GIEL = 6
GIEH = 7
; STKPTR
STKUNF = 6
STKFUL = 7
SP0 = 0
SP1 = 1
SP2 = 2
SP3 = 3
SP4 = 4
STKOVF = 7
 #DEFINE W 0
 #DEFINE F 1
 #DEFINE A 0
 #DEFINE _CLOCK 48000000
 #DEFINE CLRW CLRF 4072,0
 #DEFINE NEGW NEGF 4072,0
 #DEFINE SKPC BTFSS 4056,0,0
 #DEFINE SKPNC BTFSC 4056,0,0
 #DEFINE CLRC BCF 4056,0,0
 #DEFINE SETC BSF 4056,0,0
 #DEFINE SKPZ BTFSS 4056,2,0
 #DEFINE SKPNZ BTFSC 4056,2,0
 #DEFINE CLRZ BCF 4056,2,0
 #DEFINE SETZ BSF 4056,2,0
SB_SV0 EQU 0
SB_SV0H EQU 1
SB_SV0HH EQU 2
SB_SV0HHH EQU 3
SB_SV1 EQU 4
SB_SV1H EQU 5
SB_SV2 EQU 6
SB_SV2H EQU 7
SB_SV2HH EQU 8
SB_SV2HHH EQU 9
SB_SV3 EQU 10
SB_SV3H EQU 11
SB_SV3HH EQU 12
SB_SV3HHH EQU 13
SB_SV4 EQU 14
SB_SV4H EQU 15
SB_SV5 EQU 16
SB_SV5H EQU 17
SB_SV5HH EQU 18
SB_SV5HHH EQU 19
SB_SV6 EQU 20
SB_SV6H EQU 21
SB_SV6HH EQU 22
SB_SV6HHH EQU 23
SB_SV7 EQU 24
A0 EQU 4073
A0H EQU 4074
A1 EQU 4065
A1H EQU 4066
A2 EQU 4057
A2H EQU 4058
TBPTR EQU 4086
TBPTRH EQU 4087
PROD EQU 4083
PRODH EQU 4084
FP_REGA EQU 16
FP_REGAH EQU 17
FP_REGAHH EQU 18
FP_REGAHHH EQU 19
FP_REGB EQU 20
FP_REGBH EQU 21
FP_REGBHH EQU 22
FP_REGBHHH EQU 23
    ORG 0X001000
    GOTO SBCDSTD
    ORG 0X001008
    GOTO 0X01008
    ORG 0X001018
    GOTO 0X01018
SBDLYMS
    CLRF 5,0
SBDLYMS16
    MOVWF 4,0
    MOVLW 255
    ADDWF 4,1,0
    BTFSS 4056,0,0
    ADDWF 5,1,0
    NOP
    BTFSS 4056,0,0
    RETURN 0
    MOVLW 3
    MOVWF 1,0
    MOVLW 231
    RCALL SBDLYUS16
    BRA $ - 22
SBDLYUS
    CLRF 1,0
SBDLYUS16
    ADDLW 253
    MOVWF 0,0
    MOVLW 255
    BRA $ + 2
    BRA $ + 4
    ADDWF 0,1,0
    NOP
    BRA $ + 2
    BRA $ + 2
    BTFSS 4056,0,0
    ADDWF 1,1,0
    BTFSS 4056,0,0
    RETURN 0
    BRA $ - 16
SBCDSTD
    BSF 24,6,0
?I000000_F000_000044_M000000 ; L#MK TRISB.7 = 0
    BCF TRISB,7,0
L00000001
?I000001_F000_000047_M000000 ; L#MK PORTB.7 = 1
    BSF LATB,7,0
?I000002_F000_000048_M000000 ; L#MK DELAYMS(500)
    MOVLW 1
    MOVWF SB_SV1H,0
    MOVLW 244
    RCALL SBDLYMS16
?I000003_F000_000049_M000000 ; L#MK PORTB.7 = 0
    BCF LATB,7,0
?I000004_F000_000050_M000000 ; L#MK DELAYMS(500)
    MOVLW 1
    MOVWF SB_SV1H,0
    MOVLW 244
    RCALL SBDLYMS16
?I000005_F000_000052_M000000 ; L#MK IF PORTA.3 = 0 THEN
    BTFSC PORTA,3,0
    BRA L00000002
?I000006_F000_000053_M000000 ; L#MK ASM
GOTO 0X30
L00000002
?I000007_F000_000058_M000000 ; L#MK GOTO LOOP
    BRA L00000001
?I000008_END; L#MK
SBGLB2
    SLEEP
    BRA SBGLB2
 CONFIG CPUDIV = NOCLKDIV
 CONFIG USBDIV = OFF
 CONFIG FOSC = HS
 CONFIG PLLEN = ON
 CONFIG PCLKEN = ON
 CONFIG FCMEN = OFF
 CONFIG IESO = OFF
 CONFIG PWRTEN = ON
 CONFIG BOREN = ON
 CONFIG BORV = 22
 CONFIG WDTEN = OFF
 CONFIG WDTPS = 32768
 CONFIG HFOFST = OFF
 CONFIG MCLRE = OFF
 CONFIG STVREN = ON
 CONFIG LVP = OFF
 CONFIG BBSIZ = OFF
 CONFIG XINST = OFF
 CONFIG DEBUG = OFF
 CONFIG CP0 = OFF
 CONFIG CP1 = OFF
 CONFIG CPB = OFF
 CONFIG CPD = OFF
 CONFIG WRT0 = OFF
 CONFIG WRT1 = OFF
 CONFIG WRTC = OFF
 CONFIG WRTB = OFF
 CONFIG WRTD = OFF
 CONFIG EBTR0 = OFF
 CONFIG EBTR1 = OFF
 CONFIG EBTRB = OFF
SB#ASMEND
    END
